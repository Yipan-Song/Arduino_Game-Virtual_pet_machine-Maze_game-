#define NOTE_C5  523
#define NOTE_D5  587
#define NOTE_E5  659
#define NOTE_F5  698
#define NOTE_G5  784
#define NOTE_A5  880
#define NOTE_B5  988
#define NOTE_CS6 1109 // the notes
#include <MsTimer2.h>     
#include<Arduino.h>
#include<U8g2lib.h>
#include "Arduino_SensorKit.h" 
#ifdef U8X8_HAVE_HW_SPI
#include<SPI.h>
#endif
#ifdef U8X8_HAVE_HW_I2C
#include<Wire.h>
#endif
U8G2_SSD1306_128X64_NONAME_F_HW_I2C u8g2(U8G2_R0, /* reset=*/ U8X8_PIN_NONE);
#define BUZZER 5
#define LED 6
#define button 4  
int light_sensor = A3;
int potentiometer = A0; 
int sound_sensor = A2;   // connect the corresponding pins
int button_state = 0;  // variable for reading the pushbutton status
boolean petCheck = false;  // check if players interact with The dog （interrupt）
boolean timeClose = false;  // the status of the timer
boolean maze = false; // check if it's the maze part

// the graphics
 // hexadecimal/sexadecimal array to show graphics
#define dog_width 57
#define dog_height 64
static const unsigned char dog_bits[] PROGMEM = {
   0x00, 0x00, 0x00, 0x00, 0x00, 0x00, 0x00, 0x00, 0x00, 0xf0, 0xff, 0x3f,
   0x00, 0x00, 0x00, 0x00, 0x00, 0xfc, 0xff, 0xff, 0x01, 0x00, 0x00, 0x00,
   0x00, 0x07, 0x00, 0x80, 0x03, 0x00, 0x00, 0x00, 0xc0, 0x01, 0x00, 0x00,
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   0x00, 0x00, 0x00, 0x00, 0x00, 0x00, 0x00, 0x00};
#define sadDog_width 92
#define sadDog_height 64
static const unsigned char sadDog_bits[] PROGMEM = {
   0x00, 0x00, 0x00, 0x00, 0x00, 0x00, 0x00, 0x00, 0x00, 0x00, 0x00, 0x00,
   0x00, 0x00, 0x00, 0x00, 0xf0, 0xff, 0xff, 0x00, 0x00, 0x00, 0x00, 0x00,
   0x00, 0x00, 0x00, 0x00, 0xff, 0x9f, 0xff, 0x0f, 0x00, 0x00, 0x00, 0x00,
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   0x00, 0x00, 0x00, 0x00, 0xc0, 0xff, 0x3f, 0x00, 0x00, 0x00, 0x00, 0x00 };
#define petDog_width 79
#define petDog_height 64
static const unsigned char petDog_bits[] PROGMEM = {
0x00, 0x00, 0x00, 0x00, 0x00, 0x00, 0x00, 0x00, 0x00, 0x00, 0x00, 0x00,
   0x00, 0x00, 0x00, 0xc0, 0x07, 0x00, 0x00, 0x00, 0x00, 0x00, 0x00, 0x00,
   0x00, 0xe0, 0x0f, 0x00, 0x00, 0x00, 0x00, 0x00, 0x00, 0x00, 0x00, 0xe0,
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   0x00, 0x00, 0x00, 0x00};
#define petRemain_width 53
#define petRemain_height 64
static const unsigned char petRemain_bits[] PROGMEM = {
   0x00, 0x00, 0x00, 0x00, 0x00, 0x00, 0x00, 0x00, 0x00, 0x00, 0x00, 0x00,
   0x00, 0x00, 0x00, 0x80, 0x0f, 0x00, 0x00, 0x00, 0x00, 0x00, 0x60, 0xf8,
   0x00, 0x00, 0x00, 0x00, 0x00, 0x30, 0x80, 0x0f, 0x00, 0x00, 0x00, 0x00,
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   0x00, 0x00, 0x00, 0x00};
#define win_width 66
#define win_height 64   
static const unsigned char win_bits[] PROGMEM = {
   0x00, 0x00, 0x00, 0x40, 0x05, 0x00, 0x00, 0x00, 0x00, 0x00, 0x00, 0x00,
   0xfe, 0xff, 0x01, 0x00, 0x00, 0x00, 0x00, 0x00, 0xc0, 0xff, 0xff, 0x0f,
   0x00, 0x00, 0x00, 0x00, 0x00, 0xf8, 0xff, 0xff, 0x3f, 0x00, 0x00, 0x00,
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   0x00, 0x00, 0x00, 0x00, 0x00, 0x00, 0x00, 0x00, 0x00, 0x00, 0x00, 0x00};
#define lose_width 64
#define lose_height 64
static const unsigned char lose_bits[] PROGMEM = {
   0x00, 0x00, 0x00, 0xf0, 0x0f, 0x00, 0x00, 0x00, 0x00, 0x00, 0x80, 0xff,
   0xff, 0x01, 0x00, 0x00, 0x00, 0x00, 0xf0, 0xff, 0xff, 0x0f, 0x00, 0x00,
   0x00, 0x00, 0xfc, 0xff, 0xff, 0x3f, 0x00, 0x00, 0x00, 0x00, 0xff, 0xff,
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   0x00, 0x00, 0x00, 0xe0, 0x0f, 0x00, 0x00, 0x00};  
#define tea_width 42
#define tea_height 64
static const unsigned char tea_bits[] PROGMEM= {
   0x00, 0x00, 0x00, 0x00, 0x00, 0x00, 0x00, 0x00, 0x00, 0x00, 0x00, 0x00,
   0x00, 0x00, 0xc0, 0x03, 0x00, 0x00, 0x00, 0x00, 0xe0, 0x0f, 0x00, 0x00,
   0x00, 0x00, 0x60, 0x0c, 0x00, 0x00, 0x00, 0x00, 0xf0, 0x18, 0x00, 0x00,
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   0x00, 0x00, 0xff, 0x01, 0x00, 0x00, 0x00, 0x00, 0x00, 0x00, 0x00, 0x00 };  
#define meat_width 88
#define meat_height 64
static const unsigned char meat_bits[] PROGMEM= {
   0x00, 0x00, 0x00, 0x00, 0x00, 0x00, 0x00, 0x00, 0x00, 0x00, 0x00, 0x00,
   0x00, 0x00, 0x00, 0x00, 0x00, 0x00, 0x00, 0x00, 0x00, 0x00, 0x00, 0x00,
   0x00, 0x00, 0x00, 0x80, 0x03, 0x00, 0x00, 0x00, 0x00, 0x00, 0x00, 0x00,
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   0x00, 0x00, 0x00, 0x00, 0x00, 0x00, 0x00, 0x00 }; 
#define eat_width 64
#define eat_height 64
static const unsigned char eat_bits[] PROGMEM= {
   0x00, 0x00, 0x00, 0x00, 0xf8, 0x07, 0x00, 0x00, 0x00, 0x00, 0x00, 0x00,
   0xff, 0x3f, 0x00, 0x00, 0x00, 0x00, 0x00, 0xc0, 0xff, 0xff, 0x00, 0x00,
   0x00, 0x00, 0x00, 0xf0, 0xff, 0xff, 0x03, 0x00, 0x00, 0x00, 0x00, 0xf8,
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   0x00, 0x00, 0xfe, 0xff, 0xff, 0xff, 0x1f, 0x03 };
#define drink_width 50
#define drink_height 64
static const unsigned char drink_bits[] PROGMEM= {
   0x00, 0x00, 0x00, 0x00, 0x08, 0x00, 0x00, 0x00, 0x00, 0x00, 0x00, 0x0e,
   0x00, 0x00, 0x00, 0x00, 0x00, 0x00, 0x0f, 0x00, 0x00, 0x00, 0x00, 0x00,
   0x80, 0x0f, 0x00, 0x00, 0x00, 0x00, 0x00, 0xc0, 0x99, 0x01, 0x00, 0x00,
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   0xff, 0xff, 0x1f, 0x00 };
#define sleep_width 98
#define sleep_height 64
static const unsigned char sleep_bits[] PROGMEM= {
   0x00, 0x00, 0x00, 0x00, 0x00, 0x00, 0x00, 0x00, 0x00, 0x00, 0x00, 0x00,
   0x00, 0x00, 0x00, 0x00, 0x00, 0x00, 0x00, 0x00, 0x00, 0x00, 0x00, 0x1c,
   0x00, 0x00, 0x00, 0x00, 0x00, 0x00, 0x00, 0x00, 0x00, 0x00, 0x00, 0x00,
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   0xc0, 0x01, 0x00, 0x00 };  
#define shower_width 72
#define shower_height 64
static const unsigned char shower_bits[] PROGMEM= {
   0x00, 0x00, 0x00, 0x00, 0x00, 0xf8, 0x00, 0x00, 0x00, 0x00, 0x00, 0x00,
   0x00, 0xf0, 0xff, 0x3f, 0x00, 0x00, 0x00, 0x00, 0x3f, 0x00, 0xfc, 0x07,
   0xff, 0x01, 0x00, 0x00, 0x80, 0x7f, 0x00, 0xee, 0x00, 0xfc, 0x03, 0x00,
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   0xff, 0xff, 0xff, 0xff, 0xff, 0xff, 0xff, 0xff, 0xff, 0xff, 0xff, 0xff };
int i = 6, j = 14; // the original position/coordinate of the player
int q = 2, p; // q is the speed of the player, p is the speed of enemies
int a = 61, b = 35, c = 92, d = 35, e = 67, f = 7, g = 113, h = 35; // the original positions/coordinates of the enemies
float difX =0, difY =0; // the value the Accelerometer
int checkFir, checkSec, checkThir, checkFour; //check if the player touch the four enemies
boolean backFir = false, backSec = false, backThir = false, backFour = false; // the state that check if the enemies go back, cuz they should move repeatedly in their routes（these variables are about the route of enemies）
int melody[] = {
    NOTE_A5,
    NOTE_C5,
    NOTE_F5,
    NOTE_A5,
    NOTE_B5
};

int melodyLose[] = {
    NOTE_A5,
    NOTE_F5,
    NOTE_C5
};
// note durations: 4 = quarter note, 8 = eighth note
int noteDurations[] = {
  4,8,8,8,4
};
int noteDurationsLose[] = {
   8,8,8
};
void setup() {
  u8g2.begin(); // oled graphics
  pinMode(BUZZER, OUTPUT); // set the buzzer as output
  pinMode(LED,OUTPUT);
  pinMode(button, INPUT);
  Environment.begin();
  Oled.begin(); // use this to shouw the text
  MsTimer2::set(10000, imageChange); //set the timer(interrupt), per 10s to call the imageChange() function  
  MsTimer2::start(); // start the timer
  Environment.begin();
  Accelerometer.begin();
  pinMode(potentiometer, INPUT); //Sets the potentiometer's pinmode to input 

}
void imageChange() // interrupt
{ 
  petCheck = true; // when players haven't interated with the dog for 10s, then let "petCeck" to be true and show the remain_pet graphics and the humidity and temperature
}

void mazeMap() { // draw the maze map    
      u8g2.drawLine(4,18,4,39);
      u8g2.drawLine(18, 11, 18, 25);
      u8g2.drawLine(50, 39, 50, 60);
      u8g2.drawLine(57, 32, 57, 39);
      u8g2.drawLine(64, 4, 64, 11);
      u8g2.drawLine(64, 32, 64, 46);
      u8g2.drawLine(89,25, 89, 39);
      u8g2.drawLine(96, 32, 96, 53);
      u8g2.drawLine(110, 32, 110, 46);
      u8g2.drawLine(117, 11, 117, 39);
      u8g2.drawLine(117, 46, 117, 60);
      u8g2.drawLine(124, 4, 124, 53);
      u8g2.drawLine(64, 4, 124, 4);
      u8g2.drawLine(4, 11, 110, 11);
      u8g2.drawLine(25, 18, 117, 18);
      u8g2.drawLine(18, 25, 89, 25);
      u8g2.drawLine(57, 32, 64, 32);
      u8g2.drawLine(110, 32, 117, 32);
      u8g2.drawLine(4, 39, 57, 39);
      u8g2.drawLine(89, 39, 96, 39);
      u8g2.drawLine(57, 46, 89, 46);
      u8g2.drawLine(57, 53, 110, 53);
      u8g2.drawLine(50, 60, 124, 60);
      u8g2.drawLine(110, 46, 117, 46);
}
void enemiesDraw() { // draw the enemies
      u8g2.drawDisc(a, b, 2, U8G2_DRAW_ALL);
      u8g2.drawDisc(c, d, 2, U8G2_DRAW_ALL);
      u8g2.drawDisc(e, f, 2, U8G2_DRAW_ALL);
      u8g2.drawDisc(g, h, 2, U8G2_DRAW_ALL); 
} 
int rangePos(int x, int y, int z) { // the forward and down range that the player can move through different speed (avoid player going through the wall)(x is the range of the player's current position， y is the current position of player, z is the speed)
    x = x-2; // 2 is radius
    int r = floor((x-y)/z)*z + y; 
    return r;  
  }
int rangeNeg(int x, int y, int z) {// the backward and the up range
    x = x+2;
    int r = floor((x-y)/z)*z + y;
    return r;  
  }  
void loop() {  
    int potent_value = analogRead(potentiometer); //Read the value from the potentiometer connected to the A0 pin （the rotary knob）to control the speed in maze part or "feed dog" and "bath dog" in virtual dog part
    int potentValue = map(potent_value, 0, 1023, 0, 100); //Map the value from 0, 1023 to 0, 100
    button_state = digitalRead(button);
    difX = Accelerometer.readX(); // control the direction of the player moving (moving up and down) in maze part and let dog eat or drink in virtual pet part
    difY = Accelerometer.readY(); // control the direction of the player moving (moving forward and backward) in maze part and let dog sleep in virtual pet part
    if (button_state == HIGH) // click the button 
    {maze = !maze;} // then start the maze part or close the maze part
    if (maze) // maze game part
    {
        timeClose = true;
        MsTimer2::stop(); // close the timer
        if (potentValue >25 && potentValue <50)
        {q = 3;}
         if (potentValue >50 && potentValue <100)
        {q = 4;}
          if (potentValue <25)
        {q = 2;} // the player will move 2 pixels in every loop
         p = q-1; // this is the moving speed of the enemies
        // check if the player loses
        if ( 
        (( i > 50 && i< 117 && j > 53 && j < 60) && ( abs(a-i) < 4 &&  abs(b-j) < 4)) || (( i > 50 && i < 57 && j > 39 && j < 60 ) && ( abs(a-i) < 4 &&  abs(b-j) < 4)) || (( i > 57 && i < 64 && j > 32 && j < 46 ) && ( abs(a-i) < 4 &&  abs(b-j) < 4))||
        (( i > 89 && i< 96 && j > 25 && j < 39) && ( abs(c-i) < 4 &&  abs(d-j) < 4)) || (( i > 89 && i < 117 && j > 25 && j < 32 ) && ( abs(c-i) < 4 &&  abs(d-j) < 4)) ||
        (( i > 64 && i< 124 && j > 4 && j < 11) && ( abs(e-i) < 4 &&  abs(f-j) < 4)) || (( i > 110 && i < 117 && j > 32 && j < 46 ) && ( abs(g-i) < 4 &&  abs(h-j) < 4)) || 
        (( i > 117 && i< 124 && j > 39 && j < 46) && ( abs(g-i) < 4 &&  abs(h-j) < 4))  
        ) // if the player is in the enemies' moving range and they touch, players will lose
        { 
             u8g2.firstPage();
             do {  
                  u8g2.drawXBMP( 30, 0, lose_width, lose_height, lose_bits);
              } while( u8g2.nextPage() );
              for (int thisNote = 0; thisNote < 3; thisNote++) {
              int noteDuration = 1000 / noteDurationsLose[thisNote];  // to calculate the note duration, take one second divided by the note type, quarter note = 1000 / 4, eighth note = 1000/8     
              tone(BUZZER, melodyLose[thisNote], noteDuration);
              digitalWrite(LED, HIGH); 
              int pauseBetweenNotes = noteDuration * 1.30;  //  to distinguish the notes, set a minimum time between them, the note's duration + 30% seems to work well:      
              delay(pauseBetweenNotes);
              noTone(BUZZER); // stop the tone playing:         
              }
             i = 4; j = 14; // reset the position of the player
             a = 61; b = 35; c = 92; d = 35; e = 67; f = 7;  g = 113; h = 35;// reset the position of enemies
             delay(1000);  //ms
             digitalWrite(LED, LOW);        
        }
        // check if win
        else if ( i == rangePos(124,i,q) && j == rangePos(60,j,q)) 
       
        {  
             u8g2.firstPage();
               do {  
                   u8g2.drawXBMP( 30, 0, win_width, win_height, win_bits);
                } while( u8g2.nextPage() );
                  for (int thisNote = 0; thisNote < 5; thisNote++) {
            int noteDuration = 1000 / noteDurations[thisNote];     
            tone(BUZZER, melody[thisNote], noteDuration);
            digitalWrite(LED, HIGH); 
            int pauseBetweenNotes = noteDuration * 1.30;        
            delay(pauseBetweenNotes);     
            noTone(BUZZER);             
            }
            i = 4; j = 14;
            a = 61; b = 35; c = 92; d = 35; e = 67; f = 7;  g = 113; h = 35;
            delay(1000);
            digitalWrite(LED, LOW); 
        }
      // the route of player
      else 
      {
         if ( difY > 0.1)  // roate the base through the Y axis to let it move forward and backwark
            {
              if ( j < 25 && j > 11 && i != rangePos(18,i,q) &&  i!= rangePos(117,i,q) && i != rangePos(124,i,q)) // check the current range and position of the player, if its next step won't go through the wall, then let it go
              {i+=q;}
              if ( j > 25 && j < 32 && i != rangePos(89,i,q) && i != rangePos(117,i,q) && i != rangePos(124,i,q))
              {i+=q;}
              if ( j > 32 && j < 39 && i != rangePos(57,i,q) && i != rangePos(89,i,q) && i != rangePos(110,i,q) && i != rangePos(124,i,q) && i != rangePos(64,i,q))
              {i+=q;}
              if (j >39 && j < 46 && i != rangePos(96,i,q) && i != rangePos(110,i,q) && i != rangePos(124,i,q) && i != rangePos(64,i,q))
              {i+=q;}
              if (j >46 && j < 53 && i != rangePos(96,i,q) && i != rangePos(117,i,q) && i != rangePos(124,i,q))
              {i+=q;}
              if (j >53 && j < 60 && i != rangePos(117,i,q) && i != rangePos(124,i,q))
              {i+=q;}
              if (j >4 && j < 11 && i != rangePos(124,i,q))
              {i+=q;}
              if (j >11 && j < 18 && i < 15 && i != rangePos(117,i,q) && i != rangePos(124,i,q))
              {i+=q;}
              
            }
       if (difX > 0.1) // roate the base through the X axis to let it move up and down
          {
            if ( i < 18 && i > 4 && j != rangePos(39,j,q)) 
            {j+=q;}
             if ( i < 25 && i > 18 && j != rangePos(25,j,q) && j != rangePos(39,j,q)) 
            {j+=q;}
            if ( i < 50 && i > 25 && j != rangePos(39,j,q) && j != rangePos(18,j,q) && j != rangePos(25,j,q)) 
            {j+=q;}
            if ( i < 57 && i > 50 && j != rangePos(18,j,q) && j != rangePos(25,j,q) && j != rangePos(39,j,q) && j != rangePos(60,j,q)) 
            {j+=q;}
            if ( i < 64 && i > 57 && j != rangePos(25,j,q) && j != rangePos(18,j,q) && j != rangePos(32,j,q) && j != rangePos(53,j,q) && j != rangePos(60,j,q)) 
            {j+=q;}
            if ( i < 89 && i > 64 && j != rangePos(25,j,q) && j != rangePos(18,j,q) && j != rangePos(60,j,q) && j != rangePos(11,j,q) && j != rangePos(46,j,q) && j != rangePos(53,j,q)) 
            {j+=q;}
            if ( i < 96 && i > 89 && j != rangePos(11,j,q) && j != rangePos(39,j,q) && j != rangePos(18,j,q) && j != rangePos(53,j,q) && j != rangePos(60,j,q)) 
            {j+=q;}
            if ( i < 110 && i > 96 && j != rangePos(11,j,q) && j != rangePos(18,j,q) && j != rangePos(53,j,q) && j != rangePos(60,j,q)) 
            {j+=q;}
            if ( i < 117 && i > 110 && j != rangePos(18,j,q) && j != rangePos(32,j,q) && j != rangePos(60,j,q) && j != rangePos(46,j,q)) 
            {j+=q;}
             if ( i < 124 && i > 117 && j != rangePos(60,j,q)) 
            {j+=q;}
          }
      if ( difY < -0.1) 
          {
            if ( j < 25 && j > 11 && i != rangeNeg(18,i,q) && i != rangeNeg(117,i,q) && i != rangeNeg(4,i,q))
            {i-=q;}
            if ( j > 25 && j < 32 && i != rangeNeg(89,i,q) && i != rangeNeg(117,i,q) && i != rangeNeg(4,i,q))
            {i-=q;}
            if ( j > 32 && j < 39 && i != rangeNeg(64,i,q) && i != rangeNeg(96,i,q) && i != rangeNeg(117,i,q) && i != rangeNeg(4,i,q))
            {i-=q;}
             if (j >39 && j < 46 && i != rangeNeg(96,i,q) && i != rangeNeg(110,i,q) && i != rangeNeg(64,i,q) && i != rangeNeg(50,i,q))
            {i-=q;}
           if (j >46 && j < 53 && i != rangeNeg(96,i,q) && i != rangeNeg(117,i,q) && i != rangeNeg(50,i,q))
            {i-=q;}
            if (j >53 && j < 60 && i != rangeNeg(117,i,q) && i != rangeNeg(50,i,q))
            {i-=q;}
            if (j >4 && j < 11 && i != rangeNeg(64,i,q))
            {i-=q;}
            if (j >11 && j < 18  && i != rangeNeg(117,i,q) && i != rangeNeg(18,i,q))
            {i-=q;}
            
          }
       if (difX < -0.1) 
          {
            if ( i < 18 && i > 4 && j != rangeNeg(11,j,q)) 
            {j-=q;}
             if ( i < 25 && i > 18 && j != rangeNeg(11,j,q) && j != rangeNeg(25,j,q)) 
            {j-=q;}
            if ( i < 50 && i > 25 && j != rangeNeg(25,j,q) && j != rangeNeg(18,j,q) && j != rangeNeg(11,j,q)) 
            {j-=q;}
            if ( i < 57 && i > 50 && j != rangeNeg(18,j,q) && j != rangeNeg(25,j,q) && j != rangeNeg(11,j,q) && j != rangeNeg(39,j,q)) 
            {j-=q;}
            if ( i < 64 && i > 57 && j != rangeNeg(25,j,q) && j != rangeNeg(18,j,q) && j != rangeNeg(53,j,q) && j != rangeNeg(11,j,q) && j != rangeNeg(46,j,q) && j != rangeNeg(32,j,q)) 
            {j-=q;}
            if ( i < 89 && i > 64 && j != rangeNeg(25,j,q) && j != rangeNeg(18,j,q) && j != rangeNeg(4,j,q) && j != rangeNeg(11,j,q) && j != rangeNeg(46,j,q) && j != rangeNeg(53,j,q)) 
            {j-=q;}
            if ( i < 96 && i > 89 && j != rangeNeg(11,j,q) && j != rangeNeg(39,j,q) && j != rangeNeg(18,j,q) && j != rangeNeg(53,j,q) && j != rangeNeg(4,j,q)) 
            {j-=q;}
            if ( i < 110 && i > 96 && j != rangeNeg(11,j,q) && j != rangeNeg(18,j,q) && j != rangeNeg(53,j,q) && j != rangeNeg(4,j,q)) 
            {j-=q;}
            if ( i < 117 && i > 110 && j != rangeNeg(18,j,q) && j != rangeNeg(32,j,q) && j != rangeNeg(4,j,q) && j != rangeNeg(46,j,q)) 
            {j-=q;}
             if ( i < 124 && i > 117 && j != rangeNeg(4,j,q)) 
            {j-=q;}
          }
        u8g2.firstPage();
        do {  
            u8g2.drawCircle(i, j, 2, U8G2_DRAW_ALL); // draw the player
            mazeMap(); // draw the maze 
            enemiesDraw(); // draw the enemies
        } while( u8g2.nextPage() );
       }
    // draw the rout of enemies, the enemies keep moving in their corresponding ranges repeatedly
      if(!backFir)
      {
          if ( a>57 && a<64 && b<46 && b!= rangePos(46,b,p)) 
          { b+=p; } 
          if ( b>39 && b<46 &&  a!= rangeNeg(50,a,p))
          { a-=p; } 
           if( a>50 && a<57  && b!= rangePos(60,b,p))
          { b+=p; } 
          if( b>53 && b<60 &&  a!= rangePos(117,a,p))
          { a+=p; } 
          if ( a == rangePos(117,a,q) ) // if it has already moved to the end of its range, then let it move back
          {backFir = true;}
      }
      if (backFir) // the move back route
      {
          if ( a>57 && a<64 && b<46 && b!= rangeNeg(32,b,p)) 
          { b-=p; } 
          if ( b>39 && b<46 &&  a!= rangePos(64,a,p))
          { a+=p; } 
          if( a>50 && a<57  && b!= rangeNeg(39,b,p))
          { b-=p; } 
          if( b>53 && b<60 &&  a!= rangeNeg(50,a,p))
          { a-=p; } 
          if (b == rangeNeg(32,b,q))
          {backFir = false;}
       } 
      if (!backSec)
      {
          if (c > 89 && c < 96 && d!= rangeNeg(25,d,p) )
          {d-=p;}
          if (d > 25 && d < 32 && c!= rangePos(117,c,p))
          {c+=p;}
          if(c == rangePos(117,c,q))
          {backSec = true;}
      }
      if(backSec)
      {
         if (c > 89 && c < 96 && d!= rangePos(39,d,p) )
          {d+=p;}
          if (d > 25 && d < 32 && c!= rangeNeg(89,c,p))
          {c-=p;}
          if(d == rangePos(39,d,q))
          {backSec = false;}
      }
     if (!backThir)
      {
          if (f > 4 && f < 11 && e!= rangePos(124,e,p) )
          {e+=p;}
          if(e == rangePos(124,e,p))
          {backThir = true;}
      }
     if(backThir)
     {
          if (f > 4 && f < 11 && e!= rangeNeg(64,e,p) )
          {e-=p;}
          if(e == rangeNeg(64,e,p))
          {backThir = false;}
      }
     if (!backFour) 
      {
          if (g > 110 && g < 117 && h!= rangePos(46,h,p) )
          {h+=p;}
          if (h > 39 && h < 46 && g!= rangePos(124,g,p))
          {g+=p;}
          if(g == rangePos(124,g,q))
          {backFour = true;}
      }
     if(backFour)
     {
          if (g > 110 && g < 117 && h!= rangeNeg(32,h,p) )
          {h-=p;}
          if (h > 39 && h < 46 && g!= rangeNeg(110,g,p))
          {g-=p;}
          if(h == rangeNeg(32,h,p))
          {backFour = false;}
       }
    }
    else { // the virtual pet game part
         int soundValue = 0; 
         int sound = analogRead(sound_sensor);
         int raw_light = analogRead(light_sensor); // read the raw value from light_sensor pin (A3)
         int light = map(raw_light, 0, 1023, 0, 100); // map the value from 0, 1023 to 0, 100
         u8g2.firstPage();
         if (potentValue < 10 && light == 0){ // if the value of light sensor is 0, then assume that player is petting the dog
         do {
             u8g2.drawXBMP( 30, 0, petDog_width, petDog_height, petDog_bits); // show the petdog graphics(the happy dog)
            } while( u8g2.nextPage() );
           timeClose = true; // set the condition of timer is close
           MsTimer2::stop(); // close the timer
            for (int thisNote = 0; thisNote < 5; thisNote++) { // show the happy melody
            int noteDuration = 1000 / noteDurations[thisNote];    
            tone(BUZZER, melody[thisNote], noteDuration);
            digitalWrite(LED, HIGH); 
            int pauseBetweenNotes = noteDuration * 1.30;   
            delay(pauseBetweenNotes);
            noTone(BUZZER);      
            }
            delay(3000);
            digitalWrite(LED, LOW); // turn off the LED
         }
         else if (potentValue < 10 && sound > 700) // if the player shout to the dog or beat it(when sound value > 700)
         {
           timeClose = true; // set the condition of timer is close
           MsTimer2::stop(); // close the timer
           do {
             u8g2.drawXBMP( 30, 0, sadDog_width, sadDog_height, sadDog_bits); 
            } while( u8g2.nextPage() );
            for (int thisNote = 0; thisNote < 3; thisNote++) {   // play the unhappy melody
            int noteDuration = 1000 / noteDurationsLose[thisNote];  
            tone(BUZZER, melodyLose[thisNote], noteDuration);
            digitalWrite(LED, HIGH); 
            int pauseBetweenNotes = noteDuration * 1.30;   
            delay(pauseBetweenNotes);    
            noTone(BUZZER);        
            }
            delay(3000);
            digitalWrite(LED, LOW); 
          }
          else if (petCheck){ // players haven't interated with the dog for 10s
            do {
            u8g2.drawXBMP( 42, 0, petRemain_width, petRemain_height, petRemain_bits); // show the "asking for petting graphics"
            } while( u8g2.nextPage() );
             for (int thisNote = 0; thisNote < 3; thisNote++) {     // unhappy melody   
            int noteDuration = 1000 / noteDurationsLose[thisNote];        
            tone(BUZZER, melodyLose[thisNote], noteDuration);
            digitalWrite(LED, HIGH); 
            int pauseBetweenNotes = noteDuration * 1.30;        
            delay(pauseBetweenNotes);
            noTone(BUZZER);  
            }
            delay(3000);
            digitalWrite(LED, LOW);   // U8g2 lib
            MsTimer2::stop();
            u8g2.clearDisplay();
            Oled.setFont(u8x8_font_chroma48medium8_r); // show the text
            Oled.setCursor(2, 33); 
            Oled.print("Temperature: ");
            Oled.setCursor(2, 43); 
            Oled.print(Environment.readTemperature());
            Oled.print("C");
            Oled.setCursor(2, 53); 
            Oled.print("Humidity: ");
            Oled.setCursor(2 , 63); 
            Oled.print(Environment.readHumidity());
            Oled.print("%");
            delay(5000);
            u8g2.begin();
            petCheck = false; 
            timeClose = true; 
            MsTimer2::stop();
            digitalWrite(LED, LOW); 
         }
         else if (potentValue >10 && potentValue <40) // feed the dog (bubble tea)
         {
              timeClose = true;
              MsTimer2::stop();
              do {
                 u8g2.drawXBMP( 30, 0, tea_width, tea_height, tea_bits); // choose the bubble tea to feed the dog
               } while( u8g2.nextPage() );
              if(difX>0.5){ // rotate the base clockwise around X axis
              do {
                  u8g2.drawXBMP( 30, 0, drink_width, drink_height, drink_bits); // let the dog to drink
              } while( u8g2.nextPage() );
              for (int thisNote = 0; thisNote < 5; thisNote++) {
              int noteDuration = 1000 / noteDurations[thisNote];        
              tone(BUZZER, melody[thisNote], noteDuration);
              digitalWrite(LED, HIGH); 
              int pauseBetweenNotes = noteDuration * 1.30;        
              delay(pauseBetweenNotes);
              noTone(BUZZER);             
             }
             delay(3000);
             digitalWrite(LED, LOW); 
             }
           
         }  
         else if (potentValue >40 && potentValue <70) // feed the dog food to the dog
         {
               timeClose = true;
               MsTimer2::stop();
               do {
               u8g2.drawXBMP( 30, 0, meat_width, meat_height, meat_bits);
               } while( u8g2.nextPage() );
               if(difX>0.5){ 
               u8g2.clearDisplay();
               do {
               u8g2.drawXBMP( 30, 0, eat_width, eat_height, eat_bits);
               } while( u8g2.nextPage() );
               for (int thisNote = 0; thisNote < 5; thisNote++) {
               int noteDuration = 1000 / noteDurations[thisNote];
               tone(BUZZER, melody[thisNote], noteDuration);
               digitalWrite(LED, HIGH); 
               int pauseBetweenNotes = noteDuration * 1.30;        
               delay(pauseBetweenNotes);
               noTone(BUZZER);          
               }
               delay(3000);
               digitalWrite(LED, LOW); 
               }
         }
         else if (potentValue >70) // give the dog a bath
         {
             timeClose = true;
             MsTimer2::stop();
             do {
             u8g2.drawXBMP( 30, 0, shower_width, shower_height, shower_bits);
             } while( u8g2.nextPage() );
             for (int thisNote = 0; thisNote < 5; thisNote++) {
             int noteDuration = 1000 / noteDurations[thisNote];
             tone(BUZZER, melody[thisNote], noteDuration);            
             digitalWrite(LED, HIGH); 
             int pauseBetweenNotes = noteDuration * 1.30;
             delay(pauseBetweenNotes);
             noTone(BUZZER);             
             }
             delay(3000);
             digitalWrite(LED, LOW); 
        }           
        else if (difY>0.3 || difY<-0.3) // rotate the base along the Y axis
        {
             timeClose = true;
             MsTimer2::stop();
             do {
             u8g2.drawXBMP( 20, 0, sleep_width, sleep_height, sleep_bits); // let the dog sleep
             } while( u8g2.nextPage() );}
        else
        {
              if(timeClose){ // when timer is close
              MsTimer2::start(); //  restart the timer (after the player interacts with the dog or after remain graphics has been showed)
              timeClose = false;
            }
             do {
             u8g2.drawXBMP( 30, 0, dog_width, dog_height, dog_bits); // the original dog graphics
            } while( u8g2.nextPage() );          
        }
    }
}
